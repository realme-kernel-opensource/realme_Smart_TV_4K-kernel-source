/dts-v1/;
/plugin/;

/ {
        fragment@0 {
               target = <&soc_m7332>;
               __overlay__ {
                      android {
                          vbmeta {
                                        compatible = "android,vbmeta";
                                        parts = "vbmeta,boot,system,vendor,oem";
                                        by_name_prefix ="/dev/block/platform/mstar_mci.0/by-name/vbmeta";
                                    };
                      };
               };
        };

	fragment@1 {
		target = <&soc_m7332_backlight>;
		__overlay__ {
			led-pwm-control-support;
			led-pwm-control-channel = <0>;
			led-pwm-control-resume-period = <0xb71a>;
			led-pwm-control-resume-duty = <0xb71a>;
			led-pwm-control-resume-div = <0xff>;
			led-pwm-control-resume-polarity = <0>;
			led-pwm-control-suspend-period = <0xb71a>;
			led-pwm-control-suspend-duty = <0xb71a>;
			led-pwm-control-suspend-div = <0xff>;
			led-pwm-control-suspend-polarity = <0>;
		};
	};

};
